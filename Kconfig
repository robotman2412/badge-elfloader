## Kconfig
```kconfig
menu "Badge native apps"
	
	config BADGEABI_ENABLE_KERNEL
		bool "Enable kernel (experimental)"
		default n
		help
			Enable the kernel, sandboxing each app but increasing the system call overhead.
	
	config BADGEABI_ENABLE_MPU
		depends on BADGEABI_ENABLE_KERNEL
		bool "Enable memory protection unit"
		default y
	
endmenu
```
